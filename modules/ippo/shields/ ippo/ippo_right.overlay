#include "ippo.dtsi"

&transform {
    col-offset = <5>;
};

&kscan {
    col-gpios = <&pro_micro 5 GPIO_ACTIVE_HIGH>,
                <&pro_micro 6 GPIO_ACTIVE_HIGH>,
                <&pro_micro 7 GPIO_ACTIVE_HIGH>,
                <&pro_micro 8 GPIO_ACTIVE_HIGH>,
                <&pro_micro 9 GPIO_ACTIVE_HIGH>;
};


Copied from: zmk-config-ippo/config/boards/shields/ippo/ippo_right.overlay at aaa · take0321/zmk-config-ippo - <https://github.com/take0321/zmk-config-ippo/blob/aaa/config/boards/shields/ippo/ippo_right.overlay>
