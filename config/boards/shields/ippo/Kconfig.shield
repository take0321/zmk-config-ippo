## config/boards/shields/ippo/Kconfig.shield
```kconfig
config SHIELD_IPPO_LEFT
    def_bool $(shields_list_contains,Ippo_left)

config SHIELD_IPPO_RIGHT
    def_bool $(shields_list_contains,Ippo_right)
    
```

## config/west.yml
```yaml
manifest:
  remotes:
    - name: zmkfirmware
      url-base: https://github.com/zmkfirmware
    - name: myzmk
      url-base: https://github.com/tibiboard
    # Additional modules containing boards/shields/custom code can be listed here as well
    # See https://docs.zephyrproject.org/3.2.0/develop/west/manifest.html#projects
  projects:
    # ちびボードアプリ対応化(2026-07-20): zmkfirmware本家から
    # tibiboard/zmk-chibiboard フォークに差し替え。これでStudio編集サブシステム
    # (コンボ/タップダンス/マクロ/タイミング/status)がファームに入る。
    # コミットは実際にローカルでビルド確認したものにピン留め(chibiboard-v1.1タグの
    # 1コミット先=タイミングサブシステム追加済み)。
    - name: zmk
      remote: myzmk
      repo-path: zmk-chibiboard
      revision: 9c98ed2b0ae00afb968158e9f919056cd0f70ca8
      import: app/west.yml
  self:
    path: config
```

## modules/ippo/shields/ ippo/Kconfig.defconfig
```kconfig
if SHIELD_IPPO_LEFT

config ZMK_KEYBOARD_NAME
    default "Ippo"

config ZMK_SPLIT_ROLE_CENTRAL
    default y

endif

if SHIELD_IPPO_LEFT || SHIELD_IPPO_RIGHT

config ZMK_SPLIT
    default y

endif


Copied from: zmk-config-ippo/config/boards/shields/ippo/Kconfig.defconfig at aaa · take0321/zmk-config-ippo - <https://github.com/take0321/zmk-config-ippo/blob/aaa/config/boards/shields/ippo/Kconfig.defconfig>
```

## modules/ippo/shields/ ippo/Kconfig.shield
```kconfig
config SHIELD_IPPO_LEFT
    def_bool $(shields_list_contains,ippo_left)

config SHIELD_IPPO_RIGHT
    def_bool $(shields_list_contains,ippo_right)
    


Copied from: zmk-config-ippo/config/boards/shields/ippo/Kconfig.shield at aaa · take0321/zmk-config-ippo - <https://github.com/take0321/zmk-config-ippo/blob/aaa/config/boards/shields/ippo/Kconfig.shield>
```
