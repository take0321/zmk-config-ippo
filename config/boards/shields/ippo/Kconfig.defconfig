## config/boards/shields/ippo/Kconfig.defconfig
```kconfig
if SHIELD_IPPO_LEFT

config ZMK_KEYBOARD_NAME
    default "Ippo"

config ZMK_SPLIT_ROLE_CENTRAL
    default y

config ZMK_STUDIO
    default y

endif

if SHIELD_IPPO_LEFT || SHIELD_IPPO_RIGHT

config ZMK_SPLIT
    default y

endif
```
